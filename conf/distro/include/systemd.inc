## conf/distro/include/systemd.inc
```bitbake
# Enable systemd
DISTRO_FEATURES_BACKFILL_CONSIDERED:append = " sysvinit"
DISTRO_FEATURES:append = " systemd"
VIRTUAL-RUNTIME_init_manager = "systemd"
VIRTUAL-RUNTIME_initscripts = "systemd-compat-units"
VIRTUAL-RUNTIME_login_manager = "systemd"

# locales (which I think are needed for systemd stuff to build right)
GLIBC_GENERATE_LOCALES = "en_US.UTF-8"
IMAGE_LINGUAS = "en-us"
```

## conf/distro/no-graphics.inc
```bitbake
DISTRO_FEATURES_remove = "x11"
DISTRO_FEATURES_BACKFILL_CONSIDERED += "pulseaudio"
```

## conf/distro/systemd.inc
```bitbake
# Enable systemd
DISTRO_FEATURES_BACKFILL_CONSIDERED += "sysvinit"
DISTRO_FEATURES += "systemd"
VIRTUAL-RUNTIME_init_manager = "systemd"
VIRTUAL-RUNTIME_login_manager = "systemd"
VIRTUAL-RUNTIME_initscripts = "systemd-compat-units"

# locales (which I think are needed for systemd stuff to build right)
GLIBC_GENERATE_LOCALES = "en_US.UTF-8"
IMAGE_LINGUAS = "en-us"
DISTRO_FEATURES += "libc-locales libc-charsets libc-locale-code"
```

## conf/layer.conf
```bitbake
#
# meta-wild-common
#
# Assorted Yocto recipes by Allen Wild

BBPATH .= ":${LAYERDIR}"

BBFILES += "${LAYERDIR}/recipes*/*/*.bb \
            ${LAYERDIR}/recipes*/*/*.bbappend"

BBFILES_DYNAMIC += " \
    meta-java:${LAYERDIR}/dynamic-layers/meta-java/recipes-*/*/*.bbappend \
    rust-layer:${LAYERDIR}/dynamic-layers/meta-rust/recipes-*/*/*.bb \
    rust-layer:${LAYERDIR}/dynamic-layers/meta-rust/recipes-*/*/*.bbappend \
"

BBFILE_COLLECTIONS += "wild-common"
BBFILE_PATTERN_wild-common := "^${LAYERDIR}/"
BBFILE_PRIORITY_wild-common = "9"
LAYERDEPENDS_wild-common = "networking-layer"
LAYERSERIES_COMPAT_wild-common = "scarthgap styhead"

LICENSE_PATH += "${LAYERDIR}/custom-licenses"

# git.kernel.org is slow sometimes, google's mirror is more reliable
KERNELORG_GITMIRROR ?= "kernel.googlesource.com"
KERNELORG_GITPROTO  ?= "https"

PREFERRED_PROVIDER_virtual/java-native = "cacao-native"
PREFERRED_PROVIDER_virtual/java-initial-native = "cacao-initial-native"

PREFERRED_PROVIDER_fd-find = "${@bb.utils.contains('BBFILES_COLLECTIONS', 'rust-layer', 'fd-find', 'fd-find-bin', d)}"

# enable zstd support in squashfs tools
PACKAGECONFIG:append:pn-squashfs-tools = " zstd"
PACKAGECONFIG:append:pn-squashfs-tools-native = " zstd"
```

## meta-arch-buildhacks/conf/layer.conf
```bitbake
#
# meta-arch-buildhacks
#
# Yocto hacks to support building on Arch Linux
# Most of these compensate for
#   * python being python3
#   * gcc too new (new warnings and -Werror)
#   * glibc too new

BBPATH .= ":${LAYERDIR}"

BBFILES += "${LAYERDIR}/recipes*/*/*.bb \
            ${LAYERDIR}/recipes*/*/*.bbappend"

BBFILE_COLLECTIONS += "wild-arch-buildhacks"
BBFILE_PATTERN_wild-arch-buildhacks := "^${LAYERDIR}/"
BBFILE_PATTERN_IGNORE_EMPTY_wild-arch-buildhacks = "1"
BBFILE_PRIORITY_wild-arch-buildhacks = "20"
LAYERSERIES_COMPAT_wild-arch-buildhacks = "sumo"
```
